## defconfig
```kconfig
BR2_nios2=y
BR2_PACKAGE_HOST_LINUX_HEADERS_CUSTOM_6_1=y
BR2_TOOLCHAIN_BUILDROOT_CXX=y
BR2_TARGET_GENERIC_HOSTNAME="nios2"
BR2_TARGET_GENERIC_ISSUE="Welcome to Nios II"
BR2_INIT_NONE=y
BR2_TARGET_GENERIC_GETTY_PORT="ttyAL0"
BR2_LINUX_KERNEL=y
BR2_LINUX_KERNEL_CUSTOM_GIT=y
BR2_LINUX_KERNEL_CUSTOM_REPO_URL="https://github.com/altera-opensource/linux-socfpga.git"
BR2_LINUX_KERNEL_CUSTOM_REPO_VERSION="socfpga-6.1.55-lts"
BR2_LINUX_KERNEL_DEFCONFIG="10m50"
BR2_PACKAGE_MTD=y
BR2_PACKAGE_MTD_MKFSJFFS2=y
BR2_PACKAGE_ETHTOOL=y
BR2_PACKAGE_IPERF3=y
BR2_PACKAGE_MII_DIAG=y
BR2_PACKAGE_TCPDUMP=y
BR2_PACKAGE_URANDOM_SCRIPTS=y
BR2_TARGET_ROOTFS_CPIO=y
BR2_TARGET_ROOTFS_JFFS2=y
BR2_TARGET_ROOTFS_JFFS2_CUSTOM=y
BR2_TARGET_ROOTFS_JFFS2_CUSTOM_EBSIZE=0x10000
BR2_TARGET_UBOOT=y
BR2_TARGET_UBOOT_BOARDNAME="10m50"
BR2_TARGET_UBOOT_CUSTOM_GIT=y
BR2_TARGET_UBOOT_CUSTOM_REPO_URL="https://github.com/altera-opensource/u-boot-socfpga.git"
BR2_TARGET_UBOOT_CUSTOM_REPO_VERSION="socfpga_v2023.07"
```
